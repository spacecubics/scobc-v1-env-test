## CMakeLists.txt
```
cmake_minimum_required(VERSION 3.20.0)

find_package(Zephyr REQUIRED HINTS $ENV{ZEPHYR_BASE})
project(scobc-v1-env-test)

target_sources(app PRIVATE
  src/main.c
  src/versal_sysmon.c
  src/ddr_test.c
)
```

## prj.conf
```kconfig
# Imported from zephyr/samples/subsys/shell/shell_module/prj.conf
CONFIG_PRINTK=y
CONFIG_SHELL=y
CONFIG_LOG=y
CONFIG_LOG_CMDS=y
CONFIG_INIT_STACKS=y
CONFIG_THREAD_STACK_INFO=y
CONFIG_KERNEL_SHELL=y
CONFIG_THREAD_MONITOR=y
CONFIG_BOOT_BANNER=n
CONFIG_THREAD_NAME=y
CONFIG_DEVICE_SHELL=y
CONFIG_DATE_SHELL=y
CONFIG_THREAD_RUNTIME_STATS=y
CONFIG_THREAD_RUNTIME_STATS_USE_TIMING_FUNCTIONS=y
CONFIG_STATS=y
CONFIG_STATS_SHELL=y

CONFIG_LOG_PRINTK=y
CONFIG_LOG_MODE_IMMEDIATE=y
CONFIG_FPU=y
CONFIG_GPIO=y
```

## src/main.c
```c
#include <zephyr/kernel.h>
#include <zephyr/shell/shell.h>
#include <zephyr/sys/atomic.h>
#include <zephyr/sys/util.h>
#include <zephyr/drivers/gpio.h>
#include "versal_sysmon.h"
#include "ddr_test.h"

#define RPU_TEST_STACK_SZ	2048
#define RPU_TEST_PRIO	 	5
#define TEST_CYCLE_SEC		180
#define ZU_NODE DT_PATH(zephyr_user)

K_THREAD_STACK_DEFINE(log_temp_stack, RPU_TEST_STACK_SZ);
K_THREAD_STACK_DEFINE(stress_stack, RPU_TEST_STACK_SZ);

static const struct gpio_dt_spec pc = GPIO_DT_SPEC_GET(ZU_NODE, power_cycle_gpios);

static struct k_thread log_temp_thread;
static struct k_thread stress_thread;

static atomic_t rpu_test_running = ATOMIC_INIT(0);
static atomic_t rpu_test_stop_req = ATOMIC_INIT(0);
static int count = 0;

static volatile double fp_sink;

static void log_temp(void *p1, void *p2, void *p3)
{
	ARG_UNUSED(p1);
	ARG_UNUSED(p2);
	ARG_UNUSED(p3);

	double temp;
	uint32_t next_ms = k_uptime_get_32() + 1000u;
	uint32_t now;
	int32_t remain;

	atomic_clear(&rpu_test_stop_req);

	while (!atomic_get(&rpu_test_stop_req) && (count < TEST_CYCLE_SEC)) {
		now = k_uptime_get_32();
		remain = (int32_t)(next_ms - now);
		if (remain > 0) {
			k_sleep(K_MSEC(remain));
		}
		next_ms += 1000u;

		if (versal_sysmon_temp_read(&temp) == 0) {
			printk("Temperature: %.2f C (%d)\n", temp, ++count);
		} else {
			printk("Failed to read temperature\n");
		}
	}

	atomic_clear(&rpu_test_running);

	if (count >= TEST_CYCLE_SEC) {
		printk("Rebooting...\n");
		k_sleep(K_MSEC(100));
		gpio_pin_set_dt(&pc, 1);
	}
}

static void stress(void *p1, void *p2, void *p3)
{
	ARG_UNUSED(p1);
	ARG_UNUSED(p2);
	ARG_UNUSED(p3);

	double a;
	double b;
	double c;
	uint32_t i;

	atomic_clear(&rpu_test_stop_req);

	while (!atomic_get(&rpu_test_stop_req)) {
		a = 1.0000001;
		b = 0.9999999;
		c = 0.1234567;

		/* Heavy FP chunk */
		for (i = 0; i < 100000u; i++) {
			a = a + 1e-9 * (b - a * c);
			b = b + 1e-9 * (a - b);
			c = c + 1e-9 * (a * b - c);

			if ((i & 0x3FFu) == 0u) {
				if (a > 10.0) a -= 10.0; else if (a < -10.0) a += 10.0;
				if (b > 10.0) b -= 10.0; else if (b < -10.0) b += 10.0;
				if (c > 10.0) c -= 10.0; else if (c < -10.0) c += 10.0;
			}
		}
		fp_sink = a + b + c;

		k_sleep(K_MSEC(1));
	}

	atomic_clear(&rpu_test_running);
}

static void apu_start(void)
{
	/* Not implemented */
}

static void apu_stop(void)
{
	/* Not implemented */
}

static int rpu_test_start(void)
{
	if (atomic_cas(&rpu_test_running, 0, 1) == false) {
		return -EALREADY;
	}

	atomic_clear(&rpu_test_stop_req);

	k_thread_create(&log_temp_thread,
		log_temp_stack, K_THREAD_STACK_SIZEOF(log_temp_stack),
		log_temp,
		NULL, NULL, NULL,
		RPU_TEST_PRIO, 0, K_NO_WAIT);

	k_thread_name_set(&log_temp_thread, "log_temp");

	k_thread_create(&stress_thread,
		stress_stack, K_THREAD_STACK_SIZEOF(stress_stack),
		stress,
		NULL, NULL, NULL,
		RPU_TEST_PRIO, 0, K_NO_WAIT);

	k_thread_name_set(&stress_thread, "stress");

	return 0;
}

static int rpu_test_stop(void)
{
	if (atomic_get(&rpu_test_running) == 0) {
		return -EALREADY;
	}

	atomic_set(&rpu_test_stop_req, 1);

	k_thread_join(&log_temp_thread, K_FOREVER);
	k_thread_join(&stress_thread, K_FOREVER);

	return 0;
}

static int cmd_apu_start(const struct shell *shell, size_t argc, char **argv)
{
	ARG_UNUSED(argc);
	ARG_UNUSED(argv);

	apu_start();
	shell_print(shell, "APU started");
	return 0;
}

static int cmd_apu_stop(const struct shell *shell, size_t argc, char **argv)
{
	ARG_UNUSED(argc);
	ARG_UNUSED(argv);

	apu_stop();
	shell_print(shell, "APU stopped");
	return 0;
}

static int cmd_rpu_test_start(const struct shell *shell, size_t argc, char **argv)
{
	ARG_UNUSED(argc);
	ARG_UNUSED(argv);

	int ret = rpu_test_start();

	switch(ret) {
		case 0:
			shell_print(shell, "RPU test started");
			break;
		case -EALREADY:
			shell_warn(shell, "RPU test already running");
			break;
		default:
			shell_error(shell, "Failed to start RPU test: %d", ret);
			return ret;
	}

	return 0;
}

static int cmd_rpu_test_stop(const struct shell *shell, size_t argc, char **argv)
{
	ARG_UNUSED(argc);
	ARG_UNUSED(argv);

	int ret = rpu_test_stop();

	switch(ret) {
		case 0:
			shell_print(shell, "RPU test stopped");
			break;
		case -EALREADY:
			shell_warn(shell, "RPU test not running");
			break;
		default:
			shell_error(shell, "Failed to stop RPU test: %d", ret);
			return ret;
	}

	return 0;
}

SHELL_STATIC_SUBCMD_SET_CREATE(apu_subs,
	SHELL_CMD_ARG(start, NULL, "Start the APU", cmd_apu_start, 1, 0),
	SHELL_CMD_ARG(stop,  NULL, "Stop the APU",  cmd_apu_stop,  1, 0),
	SHELL_SUBCMD_SET_END
);

SHELL_CMD_REGISTER(apu, &apu_subs, "Start/Stop the APU", NULL);

SHELL_STATIC_SUBCMD_SET_CREATE(rpu_test_subs,
	SHELL_CMD_ARG(start, NULL, "Start the RPU test", cmd_rpu_test_start, 1, 0),
	SHELL_CMD_ARG(stop,  NULL, "Stop the RPU test",  cmd_rpu_test_stop,  1, 0),
	SHELL_SUBCMD_SET_END
);

SHELL_CMD_REGISTER(test, &rpu_test_subs, "Start/Stop the RPU test", NULL);

int main(void)
{
	if (!gpio_is_ready_dt(&pc)) {
		printk("Power cycle GPIO not ready\n");
		return -ENODEV;
	}

	gpio_pin_configure_dt(&pc, GPIO_OUTPUT_INACTIVE);

	rpu_test_start();
	apu_stop();
	return 0;
}
```

## src/ddr_test.c
```c
#include <zephyr/kernel.h>
#include <zephyr/sys/printk.h>
#include <zephyr/sys/sys_io.h>
#include <stdint.h>

#define DDR_BASE	(0x00020000u)
#define WORDS		(256u)

void ddr_test(void)
{
	uint32_t expect[WORDS];
	uint32_t got;
	int errors = 0;
	uint32_t i;
	uintptr_t addr;

	for (i = 0; i < WORDS; i++) {
		addr = (uintptr_t)DDR_BASE + (i * 4u);
		expect[i] = 0xA5A50000u ^ i ^ (uint32_t)addr;
		sys_write32(expect[i], addr);
	}

	for (i = 0; i < WORDS; i++) {
		addr = (uintptr_t)DDR_BASE + (i * 4u);
		got = sys_read32(addr);
		if (got != expect[i]) {
			printk("DDR test failed at word %u (addr 0x%08lx): expected 0x%08x, got 0x%08x\n",
				   i, (unsigned long)addr, expect[i], got);
			errors++;
		}
	}

	if (errors == 0) {
		printk("DDR: test passed\n");
	} else {
		printk("DDR: test failed with %d errors\n", errors);
	}
}
```

## src/ddr_test.h
```c
void ddr_test(void);
```

## src/versal_sysmon.c
```c
#include <zephyr/kernel.h>
#include <zephyr/sys/printk.h>
#include <zephyr/sys/sys_io.h>
#include <stdint.h>

#define SYSMON_BASE	0xF1270000u

/* Offsets in PMC_SYSMON_CSR */
#define REG_DEVICE_TEMP		0x1030u   /* instantaneous device temp (Q8.7 °C) */
#define REG_DEVICE_TEMP_MAX	0x1F90u   /* max temp since cleared (Q8.7 °C) */

static double q8_7_to_celsius_d(uint16_t raw_q8_7)
{
    int16_t s = (int16_t)raw_q8_7;
    return (double)s / 128.0;
}

int versal_sysmon_temp_read(double *temp)
{
	uint32_t v;
	uint16_t raw;

	v = sys_read32(SYSMON_BASE + REG_DEVICE_TEMP_MAX);
	raw = (uint16_t)(v & 0xFFFFu);

	/* DEVICE_TEMP_MAX reset value is 0x8000 (treat as invalid / not updated) */
	if (raw == 0x8000u) {
		return -EAGAIN;
	}

	v = sys_read32(SYSMON_BASE + REG_DEVICE_TEMP);
	raw = (uint16_t)(v & 0xFFFFu);

	if (raw == 0x8000u) {
		return -EAGAIN;
	}

	*temp = q8_7_to_celsius_d(raw);

	return 0;
}
```

## src/versal_sysmon.h
```c
int versal_sysmon_temp_read(double *temp);
```
